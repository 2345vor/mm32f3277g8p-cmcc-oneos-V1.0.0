## arch/sim/Kconfig
```kconfig
config ARCH_SIM
    bool

config ARCH_SIM_POSIX
    bool
    select ARCH_SIM

config ARCH_SIM_WIN32
    bool
    select ARCH_SIM
```

## components/net/protocols/mqtt/pahomqtt-v1.1.0/Kconfig
```kconfig
menu "pahomqtt-v1.1.0"

config NET_USING_PAHO_MQTT
    bool "Enable Paho MQTT"
    select OS_USING_TIMER_SOFT
    default n

    if NET_USING_PAHO_MQTT

        config MQTT_USING_CLIENT
            bool "Enable Paho MQTT Client"
            select NET_USING_BSD
            default n

        if MQTT_USING_CLIENT
            config MQTT_USING_TLS
                bool "Enable Paho MQTT TLS encrypt"
                select SECURITY_USING_MBEDTLS
                default n

            config MQTT_USING_SAMPLE
                bool "Enable Paho MQTT sample"
                default n
		endif

    endif

endmenu
```

## components/position/source/gnss_src/Kconfig
```kconfig
menu "GNSS Config"

    if ONEPOS_GNSS_POS
        config RVCR_USING_PROT_PARSER
        bool "GNSS using protocol parser"
        default n

        menu "GNSS RCVR PROTO"
            if RVCR_USING_PROT_PARSER
                config RVCR_USING_NMEA_0183_PROT
                bool "GNSS rcvr using nmea_0183 protocol"
                default y
            endif
        endmenu

        config RCVR_USING_RESET_OPS
        bool "GNSS rcvr supp reset operation"
        default n

        config ONEPOS_USING_GNSS_RCVR
        bool "GNSS support gnss receiver"
        default y

        if ONEPOS_USING_GNSS_RCVR
            config ONEPOS_USING_ICOFCHINA_GNSS_RCVR
            bool "Using icochina gnss receiver"
            default n

            if ONEPOS_USING_ICOFCHINA_GNSS_RCVR
                source "$OS_ROOT/components/position/source/gnss_src/icofchina/Kconfig"
            endif

            config ONEPOS_USING_UNICORECOMM_GNSS_RCVR
            bool "Using unicorecomm gnss receiver"
            default n

            if ONEPOS_USING_UNICORECOMM_GNSS_RCVR
                source "$OS_ROOT/components/position/source/gnss_src/unicorecomm/Kconfig"
            endif
        endif
    endif
endmenu
```

## components/position/source/gnss_src/icofchina/Kconfig
```kconfig
menu "ICOFCHINA Config"

    config ICOFCHINA_DEVICE_NAME
        string "ICOFCHINA using interface device name"
        default "uart2"

endmenu
```

## components/position/source/gnss_src/unicorecomm/Kconfig
```kconfig
menu "UNICORECOMM Config"

    config UNICORECOMM_DEVICE_NAME
        string "UNICORECOMM using interface device name"
        default "uart3"
        
endmenu
```

## components/security/onetls/Kconfig
```kconfig
menu "OneTLS"

    config OS_USING_ONETLS
        bool "Enable onetls"
        default n
        help 
            OneTLS is a lightweight SSL/TLS library, supporting the newest TLS 1.3 and DTLS 1.3 industry standards

        if OS_USING_ONETLS
            config ONETLS_DEBUG
                bool "Enable onetls debug"
                default y
            config ONETLS_USING_PSA
                bool "Enable psa crypto interface"
                default y
            config ONETLS_SEC_MEM_CLEAN
                bool "Enable memory cleaning for security"
                default n
            config ONETLS_SOCKET_WAIT_TIME
                hex "Socket wait time"
                default 0xFFFFFFFF
            config ONETLS_MAX_PACKET_LEN
                int "The max packet length"
                default 1024

            config ONETLS_LOG_STRING_MAX_LEN
                int "The max len of log string"
                default 255
            config ONETLS_POSIX_IO
                bool "Enable posix io"
                default y

            menu "Cipher suites"
                config ONETLS_ENABLE_TLS_AES_128_GCM_SHA256
                    bool "TLS_AES_128_GCM_SHA256"
                    default y
                config ONETLS_ENABLE_TLS_AES_256_GCM_SHA384
                    bool "TLS_AES_256_GCM_SHA384(cannot use in psk exchange mode)"
                    default n
                config ONETLS_ENABLE_TLS_CHACHA20_POLY1305_SHA256
                    bool "TLS_CHACHA20_POLY1305_SHA256"
                    default n
                config ONETLS_ENABLE_TLS_AES_128_CCM_SHA256
                    bool "TLS_AES_128_CCM_SHA256"
                    default n
                config ONETLS_ENABLE_TLS_AES_128_CCM_8_SHA256
                    bool "TLS_AES_128_CCM_8_SHA256"
                    default n
            endmenu

            menu "Curve groups"
                config ONETLS_ENABLE_ECDHE_SECP256R1
                    bool "SECP256R1"
                    default n
                config ONETLS_ENABLE_ECDHE_SECP384R1
                    bool "SECP384R1"
                    default n
                config ONETLS_ENABLE_ECDHE_SECP521R1
                    bool "SECP521R1"
                    default n
                config ONETLS_ENABLE_ECDHE_X25519
                    bool "X25519"
                    default y
                config ONETLS_ENABLE_ECDHE_X448
                    bool "X448(TODO)"
                    default n
            endmenu
        endif
endmenu 
```

## drivers/Kconfig
```kconfig
menu "Drivers"
    config OS_USING_DEVICE
        bool "Enable device manager"
        default y
    source "$OS_ROOT/drivers/*/Kconfig"
endmenu
```

## drivers/dma/Kconfig
```kconfig
menu "DMA"
    config OS_USING_DMA
        bool "Enable DMA RAM"
        default y
endmenu
```

## drivers/hal/mm32/MM32F327x_HAL/Kconfig
```kconfig
config SERIES_MM32F327X
    bool
    select ARCH_ARM_CORTEX_M3
    default n
    
config SOC_MM32F3277
    bool
    select SERIES_MM32F327X
    default n
```

## drivers/hal/mm32/MM32L3xx_HAL/Kconfig
```kconfig
config SERIES_MM32L3
    bool
    select ARCH_ARM_CORTEX_M3
    default n

config SOC_MM32L3XX
    bool
    select SERIES_MM32L3
    default n
```

## drivers/hal/mm32/drivers/Kconfig
```kconfig
if SERIES_MM32F327X
source "$OS_ROOT/drivers/hal/mm32/drivers/f327x/Kconfig"
endif

if SERIES_MM32L3
#source "$OS_ROOT/drivers/hal/mm32/drivers/l3xx/Kconfig"
endif
```

## drivers/lpmgr/Kconfig
```kconfig
menu "Low power manager"
    if OS_USING_HRTIMER_FOR_SYSTICK
        comment "please close <Using high-resolution timer for systick> [Drivers --> Timer]"
    endif
    
    if !OS_USING_HRTIMER_FOR_SYSTICK
        config OS_USING_LPMGR
        bool "Enable low power manager drivers"
        default n
        
        if OS_USING_LPMGR
            choice
                prompt "Low power options"
                default OS_USING_TICKLESS_LPMGR

                config OS_USING_TICKLESS_LPMGR
                    bool "Tickless for low power consumption"
                config OS_USING_SIMPLE_LPM
                    bool "Simple low power consumption"
            endchoice
        endif    
    endif
endmenu
```

## osal/posix/Kconfig
```kconfig
menu "POSIX compatibility layer"

config OS_USING_PTHREADS
    bool "Enable pthreads"
    select OS_USING_LIBC_ADAPTER
    default n

if OS_USING_PTHREADS
    config PTHREAD_NUM_MAX
    int "Maximum number of pthreads"
    default 8
    
    config ENABLE_POSIX_TIMER
    bool "Enable Posix Timer"
    select OS_USING_TIMER_SOFT
    default n
endif

if OS_USING_LIBC_ADAPTER && OS_USING_VFS

    if OS_USING_POSIX
    config OS_USING_POSIX_MMAP
        bool "Enable mmap"
        default n

    config OS_USING_POSIX_TERMIOS
        bool "Enable termios feature"
        default n

    config OS_USING_POSIX_AIO
        bool "Enable aio"
        default n
    endif
endif

endmenu
```

## osal/posix/source/timer/kconfig
```kconfig
if OS_USING_PTHREADS
    config ENABLE_POSIX_TIMER
       bool "Enable atest"
       default y
       select OS_USING_SHELL
       select OS_USING_DLOG
endif
```

## projects/OneOSTB6612/Kconfig
```kconfig
mainmenu "OneOS Configuration"

#Define the relative path to root directory of os code
OS_ROOT=../..
SRC_HAL=mm32

config BOARD_F3277
    bool
    select SOC_MM32F3277
    default y
    
source "$OS_ROOT/Kconfig"
```

## thirdparty/telnetd/Kconfig
```kconfig
# Kconfig file for telnetd
menu "telnetd"
    config TELNET_SERVER
    bool "enable telnet server"
    select NET_USING_BSD
    default n

endmenu
```
